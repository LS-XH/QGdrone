#include "drv_MR72_UartAv.hpp"
#include "Commulink.hpp"
#include "Basic.hpp"
#include "FreeRTOS.h"
#include "task.h"
#include "SensorsBackend.hpp"
#include "MeasurementSystem.hpp"
#include "StorageSystem.hpp"
#include "ControlSystem.hpp"

#define SensorInd 3

/*========================串口数据校验==========================================*/
static const uint8_t crc8_table[] = {
	0x00, 0x07, 0x0e, 0x09, 0x1c, 0x1b, 0x12, 0x15, 0x38, 0x3f, 0x36, 0x31,
	0x24, 0x23, 0x2a, 0x2d, 0x70, 0x77, 0x7e, 0x79, 0x6c, 0x6b, 0x62, 0x65,
	0x48, 0x4f, 0x46, 0x41, 0x54, 0x53, 0x5a, 0x5d, 0xe0, 0xe7, 0xee, 0xe9,
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	0xfa, 0xfd, 0xf4, 0xf3
};

//校验计算
uint8_t crc_crc8(const uint8_t *p, uint8_t len)
{
	uint16_t i;
	uint16_t crc = 0x0;
	while (len--) {
	i = (crc ^ *p++) & 0xFF;
	crc = (crc8_table[i] ^ (crc << 8)) & 0xFF;
	}
	return crc & 0xFF;
}


/*========================数据处理========================*/
struct DriverInfo
{
	uint32_t param;
	Port port;
};


static const uint8_t Sequence_Start[2] = { 0x54 , 0x48 };

static void MR72_Server(void* pvParameters)
{
	DriverInfo driver_info = *(DriverInfo*)pvParameters;
	delete (DriverInfo*)pvParameters;
	
	uint32_t sensor_key1 = registere_AvTarget();
	//获取避障参数
	const AvoidanceCfg* avCfg = getAvCfg();
	
	uint8_t Rx_Len = 18;
	if( driver_info.param > 1 )
		 Rx_Len = 19;
	
	uint8_t rxdata[Rx_Len];
	volatile uint8_t rc_counter = 0;
	while(1)
	{
		uint8_t data;
		if( driver_info.port.read( &data, 1, -1, -1) )
		{
			if( rc_counter < 2 )
			{
				//接收包头
				if( data != Sequence_Start[ rc_counter ] )
					rc_counter = 0;
				else
				{
					rxdata[rc_counter] = data;
					++rc_counter;
				}
			}	
			else if( rc_counter < Rx_Len )
			{	//接收消息和ID
				rxdata[ rc_counter ] = data;
				++rc_counter;
			}
			else
			{	//接收校验	
				uint8_t crc = crc_crc8(rxdata,Rx_Len);		
				if( data == crc )
				{//校验通过
					double MR72_Range[3];
				  MR72_Range[0] = rxdata[16] * 0x100 + rxdata[17];
					MR72_Range[1] = rxdata[2] * 0x100 + rxdata[3];
					MR72_Range[2] = rxdata[4] * 0x100 + rxdata[5];	
				
				  MR72_Range[0] = ((MR72_Range[0] == 0xffff) ? 0 : MR72_Range[0]) * (Rx_Len==19 ? 0.001 : 0.01);
				  MR72_Range[1] = ((MR72_Range[1] == 0xffff) ? 0 : MR72_Range[1]) * (Rx_Len==19 ? 0.001 : 0.01);
				  MR72_Range[2] = ((MR72_Range[2] == 0xffff) ? 0 : MR72_Range[2]) * (Rx_Len==19 ? 0.001 : 0.01);
					
					double range = MR72_Range[1]*100;
					if( range>avCfg->wheelbase[0] && MR72_Range[1]<65500 ) {
						vector2<double> dis;
						dis.x = range;
						set_AvTargetXYStraightLine_RelativeFlu( sensor_key1, dis );
					}
					else
						set_AvTargetInavailable(sensor_key1);
				}
				rc_counter = 0;				
			}				
		}			
		
	}		
}
static bool MR72_DriverInit( Port port, uint32_t param )
{
	//波特率115200
	port.SetBaudRate( 115200, 2, 2 );

	DriverInfo* driver_info = new DriverInfo;
	driver_info->param = param;
	driver_info->port = port;
	xTaskCreate( MR72_Server, "MR72_Server", 1024, (void*)driver_info, SysPriority_ExtSensor, NULL);
	return true;
}

void init_drv_MR72_UartAv()
{
	PortFunc_Register( 83, MR72_DriverInit );
}